#include "chewy.dtsi"


&default_transform {
    col-offset = <1>;
};

&kscan0 {
    col-gpios
        = <&gpio0 24 GPIO_ACTIVE_HIGH>
        ;
        
    row-gpios
        = <&gpio1 0 (GPIO_ACTIVE_HIGH | GPIO_PULL_DOWN)>
        ;
};
